## board/technologic/ts11000/Kconfig
```kconfig
if TARGET_IMX95_TS11000

config SYS_BOARD
	default "ts11000"

config SYS_VENDOR
	default "technologic"

config SYS_CONFIG_NAME
	default "ts11000"

endif
```

## board/technologic/ts4300/Kconfig
```kconfig
if TARGET_IMX93_TS4300

config SYS_BOARD
	default "ts4300"

config SYS_VENDOR
	default "technologic"

config SYS_CONFIG_NAME
	default "ts4300"

config DDR_MEM_SIZE
	hex "DDR4 size used to select correct initialization."
	default 0x10000000

endif
```

## board/technologic/ts9390/Kconfig
```kconfig
if TARGET_IMX93_TS9390

config SYS_BOARD
	default "ts9390"

config SYS_VENDOR
	default "technologic"

config SYS_CONFIG_NAME
	default "ts9390"

config DDR_MEM_SIZE
	hex "DDR4 size used to select correct initialization."
	default 0x10000000
endif
```

## drivers/bus/Kconfig
```kconfig
# SPDX-License-Identifier: GPL-2.0
#
# Bus Devices
#

menu "Bus devices"

config NXP_FSPI_BUS
	bool "NXP FlexSPI as a memory-mapped bus"
	depends on DM && ARCH_IMX9
	help
	  Enable support for the NXP FlexSPI controller as a generic
	  memory-mapped bus.

	  This driver configures the FlexSPI peripheral in its AHB bus
	  mode, allowing it to be used as a parallel bus for accessing
	  memory-mapped peripherals (like an FPGA) instead of as an
	  SPI MTD (flash) controller.

config TI_PWMSS
	bool
	default y if ARCH_OMAP2PLUS && PWM_TI_EHRPWM
	help
	  PWM Subsystem driver support for AM33xx SOC.

config TI_SYSC
	bool "TI sysc interconnect target module driver"
	depends on DM && ARCH_OMAP2PLUS
	help
	  Generic driver for Texas Instruments interconnect target module
	  found on many TI SoCs.

config SPL_TI_SYSC
	bool "Support TI sysc interconnect in SPL"
	depends on SPL_DM && TI_SYSC
	help
	  Generic driver for Texas Instruments interconnect target module
	  found on many TI SoCs.

config UNIPHIER_SYSTEM_BUS
	bool "UniPhier System Bus driver"
	depends on ARCH_UNIPHIER
	default y
	help
	  Support for UniPhier System Bus, a simple external bus.  This is
	  needed to use on-board devices connected to UniPhier SoCs.

endmenu
```
